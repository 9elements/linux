## Documentation/devicetree/bindings/hwmon/maxim,max6639.yaml
```yaml
# SPDX-License-Identifier: (GPL-2.0 OR BSD-2-Clause)
%YAML 1.2
---

$id: http://devicetree.org/schemas/hwmon/maxim,max6639.yaml#
$schema: http://devicetree.org/meta-schemas/core.yaml#

title: Maxim max6639

maintainers:
  - Roland Stigge <stigge@antcom.de>

description: |
  The MAX6639 is a 2-channel temperature monitor with dual, automatic, PWM
  fan-speed controller.  It monitors its own temperature and one external
  diode-connected transistor or the temperatures of two external diode-connected
  transistors, typically available in CPUs, FPGAs, or GPUs.

  Datasheets:
    https://datasheets.maximintegrated.com/en/ds/MAX6639-MAX6639F.pdf

properties:
  compatible:
    enum:
      - maxim,max6639

  reg:
    maxItems: 1

  '#address-cells':
    const: 1

  '#size-cells':
    const: 0

required:
  - compatible
  - reg

additionalProperties: false

patternProperties:
  "^ot[0-1]_indication$":
    type: boolean
    default: false
    description:
      If true then enable OT pin indication.

  "^therm[0-1]_indication$":
    type: boolean
    default: false
    description:
      If true then enable THERM pin indication.

  "^fan@[0-1]$":
    type: object
    description: |
      Represents the two fans and their specific configuration.

    properties:
      reg:
        description: |
          The fan number.
        items:
          minimum: 0
          maximum: 1

      pwm-polarity:
        type: boolean
        default: 1
        description:
          PWM output is low at 100% duty cycle when this bit is set to zero. PWM
          output is high at 100% duty cycle when this bit is set to 1.

      pwm-init:
        description:
          Value specifying the initial pwm during driver probe.
        items:
          minimum: 0
          maximum: 255

      pulses-per-revolution:
        $ref: /schemas/types.yaml#/definitions/uint32
        enum: [1, 2, 3, 4]
        default: 2
        description:
          Value specifying the number of pulses per revolution of the controlled
          FAN.

      maxim,rpm-range:
        $ref: /schemas/types.yaml#/definitions/uint32
        enum: [2000, 4000, 8000, 16000]
        default: 4000
        description:
          Scales the tachometer counter by setting the maximum (full-scale) value
          of the RPM range for max6639.

      fan-spin-up:
        type: boolean
        default: false
        description:
          If true then enable running fan at 100% for 2 second when
          fan is not spinning.

      full-speed-on-therm:
        type: boolean
        default: false
        description:
          If true then enable running fan at 100% on fan fail event.

      fanfail_indication:
        type: boolean
        default: false
        description:
          If true then enable fanfail pin indication.
    required:
      - reg

examples:
  - |
    i2c {
      #address-cells = <1>;
      #size-cells = <0>;

      max6639@10 {
        compatible = "maxim,max6639";
        reg = <0x10>;
        #address-cells = <1>;
        #size-cells = <0>;

        fan@0 {
          reg = <0x0>;
          pwm-polarity = <1>;
          pulses-per-revolution = <2>;
          maxim,rpm-range = <4000>;
        };

        fan@1 {
          reg = <0x1>;
          pwm-polarity = <1>;
          pulses-per-revolution = <2>;
          maxim,rpm-range = <4000>;
        };
      };
    };
...
```

## Documentation/devicetree/bindings/hwmon/pmbus/vicor,bcm6123.yaml
```yaml
# SPDX-License-Identifier: (GPL-2.0 OR BSD-2-Clause)
%YAML 1.2
---

$id: http://devicetree.org/schemas/hwmon/pmbus/vicor,bcm6123.yaml#
$schema: http://devicetree.org/meta-schemas/core.yaml#

title: Vicor Corporation BCM6123 Bus Converter

maintainers:
  - Patrick Rudolph <patrick.rudolph@9elements.com>

description: |
  The BCM6123 is an isolated Fixed-Ratio DC-DC Converter,
  operating from a 260V to 410V primary bus to deliver an unregulated
  ratiometric secondary voltage.

  Datasheet: https://www.vicorpower.com/documents/datasheets/ds_BCM6123xD1E5135yzz.pdf

properties:
  compatible:
    enum:
      - vicor,bcm6123

  reg:
    maxItems: 1

required:
  - compatible
  - reg

additionalProperties: false

examples:
  - |
    i2c {
        #address-cells = <1>;
        #size-cells = <0>;

        bcm6123@5f {
            compatible = "vicor,bcm6123";
            reg = <0x5f>;
        };
    };
```

## Documentation/devicetree/bindings/i2c/i2c-mux-max735x.yaml
```yaml
# SPDX-License-Identifier: GPL-2.0
%YAML 1.2
---
$id: http://devicetree.org/schemas/i2c/i2c-mux-max735x.yaml#
$schema: http://devicetree.org/meta-schemas/core.yaml#

title: Maxim MAX735x/MAX736x I2C bus switch

maintainers:
  - Laurent Pinchart <laurent.pinchart@ideasonboard.com>

description:
  The binding supports Maxim MAX735x and MAX736x I2C mux/switch devices.

allOf:
  - $ref: /schemas/i2c/i2c-mux.yaml#
  - if:
      properties:
        compatible:
          contains:
            enum:
              - maxim,max7367
              - maxim,max7369
    then:
      properties:
        interrupts: true

        "#interrupt-cells":
          const: 2

        interrupt-controller: true

properties:
  compatible:
    oneOf:
      - enum:
          - maxim,max7356
          - maxim,max7357
          - maxim,max7358
          - maxim,max7367
          - maxim,max7368
          - maxim,max7369

  reg:
    maxItems: 1

  reset-gpios:
    maxItems: 1

  i2c-mux-idle-disconnect:
    type: boolean
    description: Forces mux to disconnect all children in idle state. This is
      necessary for example, if there are several multiplexers on the bus and
      the devices behind them use same I2C addresses.

  idle-state:
    description: if present, overrides i2c-mux-idle-disconnect
    $ref: /schemas/mux/mux-controller.yaml#/properties/idle-state

required:
  - compatible
  - reg

unevaluatedProperties: false

examples:
  - |
    i2c {
        #address-cells = <1>;
        #size-cells = <0>;

        i2c-mux@74 {
            compatible = "maxim,max7357";
            #address-cells = <1>;
            #size-cells = <0>;
            reg = <0x74>;

            i2c@1 {
                #address-cells = <1>;
                #size-cells = <0>;
                reg = <1>;

                eeprom@54 {
                    compatible = "atmel,24c08";
                    reg = <0x54>;
                };
            };

            i2c@7 {
                #address-cells = <1>;
                #size-cells = <0>;
                reg = <7>;

                rtc@51 {
                    compatible = "nxp,pcf8563";
                    reg = <0x51>;
                };
            };
        };
    };
...
```

## Documentation/devicetree/bindings/pinctrl/cypress,cy8c95x0.yaml
```yaml
# SPDX-License-Identifier: (GPL-2.0-only OR BSD-2-Clause)
%YAML 1.2
---
$id: http://devicetree.org/schemas/pinctrl/cypress,cy8c95x0.yaml#
$schema: http://devicetree.org/meta-schemas/core.yaml#

title: Cypress CY8C95X0 I2C GPIO expander

maintainers:
  - Patrick Rudolph <patrick.rudolph@9elements.com>

description: |
  This supports the 20/40/60 pin Cypress CYC95x0 GPIO I2C expanders.
  Pin function configuration is performed on a per-pin basis.

properties:
  compatible:
    enum:
      - cypress,cy8c9520
      - cypress,cy8c9540
      - cypress,cy8c9560

  #address-cells:
    const: 2

  reg:
    maxItems: 1

  gpio-controller: true

  '#gpio-cells':
    description:
      The first cell is the pin number and the second cell is used
      to specify optional parameters.
    const: 2

  interrupts:
    maxItems: 1

  interrupt-controller: true

  '#interrupt-cells':
    description:
      Specifies the pin number and flags, as defined in
      include/dt-bindings/interrupt-controller/irq.h
    const: 2

  ngpios:
    minimum: 1
    maximum: 60

  gpio-line-names:
    minItems: 1
    maxItems: 60

  vdd-supply:
    description:
      Optional power supply.

patternProperties:
  '-pins$':
    type: object
    description:
      Pinctrl node's client devices use subnodes for desired pin configuration.
      Client device subnodes use below standard properties.
    $ref: "/schemas/pinctrl/pincfg-node.yaml"

    properties:
      pins:
        description:
          List of gpio pins affected by the properties specified in this
          subnode.
        items:
          oneOf:
            - pattern: "^gp([0-7][0-7])$"
        minItems: 1
        maxItems: 60

      function:
        enum: [ gpio, pwm ]

        description:
          Specify the alternative function to be configured for the specified
          pins.

      bias-pull-down: true

      bias-pull-up: true

      bias-disable: true

      output-high: true

      output-low: true

      drive-push-pull: true

      drive-open-drain: true

      drive-open-source: true

    required:
      - pins
      - function

    additionalProperties: false

required:
  - compatible
  - reg
  - interrupts
  - interrupt-controller
  - '#interrupt-cells'
  - gpio-controller
  - '#gpio-cells'
  - gpio-ranges

additionalProperties: false

examples:
  - |
    gpo0: gpo@20 {
        #address-cells = <1>;
        #size-cells = <0>;
        compatible = "cypress,cy8c9520";
        reg = <0x20>;
        gpio-controller;
        #gpio-cells = <2>;
        #interrupt-cells=<2>;
        interrupt-parent = <&irq_ctrl>;
        interrupts = <10 IRQ_TYPE_LEVEL_HIGH>;
        interrupt-controller;
        vdd-supply = <&p3v3>;
        ngpios = <16>;
        gpio-reserved-ranges = <5 1>;

        gpio-line-names =
        /* GPORT0 */
        "", "PWRGD_PVTT_ABC_CPU0",
        "SMB_VR_CPU0_PVCCIN_ALERT", "SMB_VR_CPU0_DEF_ALERT",
        "PWRGD_PVTT_DEF_CPU0", "", "RST_LVC3_CPU0_RESET_N",
        "SMB_VR_CPU0_PVCCIO_ALERT",
        /* GPORT1 */
        "FM_CPU0_ADR_COMPLETE_DLY", "FM_CPU0_ADR_COMPLETE_N",
        "PWRGD_LVC3_CPU0_PWRGOOD", "H_LVT3_CPU0_PROCHOT_N",
        "H_LVT3_CPU0_MEM_ABC_HOT_N", "H_LVT3_CPU0_MEM_DEF_HOT_N",
        "PWRGD_LVC3_CPU0_ABC_DRAM_G", "PWRGD_LVC3_CPU0_DEF_DRAM_G";
    };
```

## Documentation/devicetree/bindings/regulator/max5970.yaml
```yaml
# SPDX-License-Identifier: (GPL-2.0 OR BSD-2-Clause)
%YAML 1.2
---
$id: http://devicetree.org/schemas/regulator/max5970.yaml#
$schema: http://devicetree.org/meta-schemas/core.yaml#

title: Regulator driver for MAX5970 smart switch from Maxim Integrated.

maintainers:
  - Patrick Rudolph <patrick.rudolph@9elements.com>

description: |
  The smart switch provides no output regulation, but independent fault protection
  and voltage and current sensing.
  Programming is done through I2C bus.

  Datasheets:
    https://datasheets.maximintegrated.com/en/ds/MAX5970.pdf
    https://datasheets.maximintegrated.com/en/ds/MAX5978.pdf

properties:
  compatible:
    enum:
      - maxim,max5970
      - maxim,max5978

  reg:
    maxItems: 1

  interrupts:
    maxItems: 1

  vss1-supply:
    description: Supply of the first channel.

  vss2-supply:
    description: Supply of the second channel (MAX5970 only).

  io-channels:
    items:
      - description: voltage first channel
      - description: current first channel
      - description: voltage second channel (MAX5970 only)
      - description: current second channel (MAX5970 only)
    description: |
      Voltage and current for first channel and second channel (MAX5970 only).

  "#io-channel-cells":
    const: 1

  regulators:
    type: object
    description:
      Properties for single channel.

    patternProperties:
      "^(sw[0-1])$":
        $ref: "regulator.yaml#"
        type: object

      shunt-resistor-micro-ohms:
        description: |
          The value of curent sense resistor in microohms.
          Must be specified for each channel.

    additionalProperties: true

additionalProperties: false

required:
  - compatible
  - reg
  - regulators

examples:
  - |
    i2c {
            #address-cells = <1>;
            #size-cells = <0>;

            regulator@3a {
                    reg = <0x3a>;
                    vss1-supply = <&p3v3>;
                    compatible = "maxim,max5978";

                    regulators {
                            sw0_ref_0: SW0 {
                                   regulator-compatible = "SW0";
                                   shunt-resistor-micro-ohms = <12000>;
                            };
                    };
            };
    };

  - |
    i2c {
            #address-cells = <1>;
            #size-cells = <0>;

            regulator@3a {
                    reg = <0x3a>;
                    vss1-supply = <&p3v3>;
                    vss2-supply = <&p5v>;
                    compatible = "maxim,max5970";

                    regulators {
                            sw0_ref_1: SW0 {
                                   regulator-compatible = "SW0";
                                   shunt-resistor-micro-ohms = <12000>;
                            };
                            sw1_ref_1: SW1 {
                                   regulator-compatible = "SW1";
                                   shunt-resistor-micro-ohms = <10000>;
                            };
                    };
            };
    };
...
```

## Documentation/devicetree/bindings/regulator/userspace-consumer.yaml
```yaml
# SPDX-License-Identifier: (GPL-2.0 OR BSD-2-Clause)
%YAML 1.2
---
$id: http://devicetree.org/schemas/regulator/userspace-consumer.yaml#
$schema: http://devicetree.org/meta-schemas/core.yaml#

title: Regulator userspace consumer driver

maintainers:
  - Patrick Rudolph <patrick.rudolph@9elements.com>

description: |
  Regulator userspace consumer driver helps interact with regulator.
  Optionally uses sysfs notify to capture regulator events into userspace
  application.
  This enables userspace application to monitor events in regulator(s) &
  handle them appropriately.


properties:
  compatible:
    enum:
      - reg-userspace-consumer

  regulator-name:
    description: Name of the consumer line

  regulator-boot-on:
    description: Enable regulator during boot

  regulator-supplies:
    description: Supply names for this regulator. This can be multiple strings

  regulator-notify-enable:
    description: Enable sysfs notify for regulator events

patternProperties:
  ".*-supply$":
    description: |
      Input supply phandle(s) for this node. There should be
      <supply-name>-supply to pass regulators handle

required:
  - compatible
  - regulator-supplies
  - ".*-supply$"

additionalProperties: false

examples:
  - |
    p12v_b_consumer {
        compatible = "reg-userspace-consumer";
        regulator-name = "BCM1";
        regulator-supplies = "vbus";
        vbus-supply = <&p12v_b>;
    };

    ssb_rssd32 {
        compatible = "reg-userspace-consumer";
        regulator-name = "ssb_rssd32";
        regulator-supplies = "sw0", "sw1";
        sw0-supply = <&sw0_ssb_rssd32>;
        sw1-supply = <&sw1_ssb_rssd32>;
    };
...
```

## drivers/Kconfig.rej
```kconfig
--- drivers/Kconfig
+++ drivers/Kconfig
@@ -236,4 +236,7 @@ source "drivers/interconnect/Kconfig"
 source "drivers/counter/Kconfig"
 
 source "drivers/most/Kconfig"
+
+source "drivers/peci/Kconfig"
+
 endmenu
```
